## main/Kconfig.projbuild
```kconfig
menu "Ameng companion"

config AMENG_AI_ENABLE
    bool "Enable optional cloud AI dialogue"
    default n
    help
        Local pet logic always works without AI. When enabled, TALK may call an
        OpenAI-compatible Chat Completions endpoint. Credentials stay in the
        local sdkconfig; do not commit them.

config AMENG_WIFI_SSID
    string "2.4 GHz Wi-Fi SSID (also used for real-time clock sync)"
    default ""
    help
        Optional. When configured, Ameng connects to Wi-Fi even if cloud AI is
        disabled, so SNTP can keep the displayed clock and offline elapsed time
        synchronized with the real world.

config AMENG_WIFI_PASSWORD
    string "Wi-Fi password"
    default ""

config AMENG_AI_ENDPOINT
    string "AI Chat Completions endpoint"
    default "https://api.openai.com/v1/chat/completions"
    depends on AMENG_AI_ENABLE

config AMENG_AI_MODEL
    string "AI model name"
    default "gpt-4o-mini"
    depends on AMENG_AI_ENABLE

config AMENG_AI_API_KEY
    string "AI API key"
    default ""
    depends on AMENG_AI_ENABLE

endmenu
```

## sdkconfig.defaults
```kconfig
# --- Target ---
CONFIG_IDF_TARGET="esp32c3"

# --- Flash ---
CONFIG_ESPTOOLPY_FLASHSIZE_8MB=y
CONFIG_ESPTOOLPY_HEADER_FLASHSIZE_UPDATE=n
CONFIG_PARTITION_TABLE_CUSTOM=y
CONFIG_PARTITION_TABLE_CUSTOM_FILENAME="partitions.csv"
CONFIG_PARTITION_TABLE_FILENAME="partitions.csv"

# --- Console: native USB Serial/JTAG ---
CONFIG_ESP_CONSOLE_USB_SERIAL_JTAG=y
CONFIG_ESP_CONSOLE_SECONDARY_NONE=y

# --- LVGL ---
CONFIG_LV_COLOR_DEPTH_16=y
CONFIG_LV_DEF_REFR_PERIOD=20
CONFIG_LV_FONT_MONTSERRAT_14=y
CONFIG_LV_FONT_MONTSERRAT_20=y
CONFIG_LV_MEM_SIZE_KILOBYTES=24

# --- TLS for optional AI endpoint ---
CONFIG_MBEDTLS_CERTIFICATE_BUNDLE=y
CONFIG_MBEDTLS_DEFAULT_CERTIFICATE_BUNDLE=y

# --- System ---
CONFIG_FREERTOS_HZ=1000
```
